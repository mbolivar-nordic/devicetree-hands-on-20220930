## simple-bindings/dts/bindings/intel,foo.yaml
```yaml
description: |
  A binding for the (fake) Nordic "foo" device.
compatible: nordic,foo
include: base.yaml

# Uncomment and add the missing 'fifo-depth'
# property definition below:

# properties:
#   ...
```

## solutions/labels-and-phandles/dts/bindings/some-device.yaml
```yaml
description: |
  Some device of interest, has a message
  property that we want to read.
compatible: some-device

properties:
  message:
    type: string
```

## solutions/simple-bindings/dts/bindings/nordic,foo.yaml
```yaml
description: |
  A binding for the (fake) Intel "foo" device.
compatible: intel,foo
include: base.yaml

# Uncomment and add the missing 'num-channels'
# property definition below:

properties:
  num-channels:
    type: int
```
